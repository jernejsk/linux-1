## Documentation/devicetree/bindings/usb/allwinner,sun60i-a733-dwc3.yaml
```yaml
# SPDX-License-Identifier: (GPL-2.0-only OR BSD-2-Clause)
%YAML 1.2
---
$id: http://devicetree.org/schemas/usb/allwinner,sun60i-a733-dwc3.yaml#
$schema: http://devicetree.org/meta-schemas/core.yaml#

title: Allwinner A733 DWC3 USB controller glue

maintainers:
  - Jernej Skrabec <jernej.skrabec@gmail.com>

description:
  The A733 wraps a DesignWare USB3.1 DRD controller with clocks and a
  reset that the controller core does not know about, so the glue node
  owns them and the controller itself is a child node.

properties:
  compatible:
    const: allwinner,sun60i-a733-dwc3

  "#address-cells":
    const: 1

  "#size-cells":
    const: 1

  ranges: true

  clocks:
    items:
      - description: AHB slave clock
      - description: AXI master clock
      - description: USB2 PHY reference clock
      - description: Suspend clock
      - description: Microframe clock
      - description: UTMI clock
      - description: PIPE clock

  clock-names:
    items:
      - const: hclk
      - const: aclk
      - const: ref
      - const: suspend
      - const: mf
      - const: utmi
      - const: pipe

  resets:
    maxItems: 1

  power-domains:
    maxItems: 1

patternProperties:
  "^usb@[0-9a-f]+$":
    $ref: snps,dwc3.yaml#
    description: The controller itself.

required:
  - compatible
  - "#address-cells"
  - "#size-cells"
  - ranges
  - clocks
  - clock-names
  - resets
  - power-domains

additionalProperties: false

examples:
  - |
    #include <dt-bindings/clock/sun60i-a733-ccu.h>
    #include <dt-bindings/clock/sun60i-a733-serdes-ccu.h>
    #include <dt-bindings/interrupt-controller/arm-gic.h>
    #include <dt-bindings/power/allwinner,sun60i-a733-pck-600.h>
    #include <dt-bindings/reset/sun60i-a733-ccu.h>

    usb@6a00000 {
        compatible = "allwinner,sun60i-a733-dwc3";
        #address-cells = <1>;
        #size-cells = <1>;
        ranges = <0x06a00000 0x06a00000 0x200000>;
        clocks = <&serdes_ccu CLK_SERDES_USB3_HCLK>,
                 <&serdes_ccu CLK_SERDES_USB3_ACLK>,
                 <&ccu CLK_USB2_U2_REF>,
                 <&ccu CLK_USB2_SUSPEND>,
                 <&ccu CLK_USB2_MF>,
                 <&ccu CLK_USB2_U3_UTMI>,
                 <&serdes_ccu CLK_SERDES_USB3_PIPE>;
        clock-names = "hclk", "aclk", "ref", "suspend", "mf", "utmi", "pipe";
        resets = <&ccu RST_BUS_USB2>;
        power-domains = <&pck600 PD_USB2>;

        usb@6a00000 {
            compatible = "snps,dwc3";
            reg = <0x06a00000 0x100000>;
            interrupts = <GIC_SPI 155 IRQ_TYPE_LEVEL_HIGH>;
            phys = <&usbphy 2>;
            phy-names = "usb2-phy";
            phy_type = "utmi";
            dr_mode = "host";
            maximum-speed = "high-speed";
        };
    };

...
```

## drivers/media/platform/sunxi/sun50i-di300/Kconfig
```kconfig
# SPDX-License-Identifier: GPL-2.0-only
config VIDEO_SUN50I_DI300
	tristate "Allwinner DI300 deinterlace driver"
	depends on V4L_MEM2MEM_DRIVERS
	depends on VIDEO_DEV
	depends on ARCH_SUNXI || COMPILE_TEST
	depends on COMMON_CLK && OF
	depends on PM
	select VIDEOBUF2_DMA_CONTIG
	select V4L2_MEM2MEM_DEV
	help
	   Support for the Allwinner DI300 deinterlace unit found on
	   H616 and later SoCs.

	   To compile this driver as a module choose m here.
```

## drivers/net/wireless/aicsemi/aic8800/Kconfig
```kconfig
# SPDX-License-Identifier: GPL-2.0-only
config AIC8800
	tristate "AICSemi AIC8800 series wireless support"
	depends on CFG80211
	depends on MMC
	select CRC8
	help
	  This is the driver for the AICSemi AIC8800 family of Wi-Fi chipsets.
	  The AIC8800D80 is an 802.11ax (Wi-Fi 6) 1x1 combo device found on
	  several Allwinner and Rockchip single board computers, where it is
	  attached over SDIO.

	  The driver talks to the on-chip full-MAC firmware, which has to be
	  provided by userspace through the firmware loader.

	  Say Y or M here if your board has an AIC8800 series device.
```

## drivers/net/wireless/unisoc/Kconfig
```kconfig
# SPDX-License-Identifier: GPL-2.0-only

menuconfig WLAN_VENDOR_UNISOC
	bool "Unisoc wireless devices"
	default y
	help
	  This option enables the Unisoc wireless-driver menu. It does not
	  build a driver by itself. Choose the controller-specific options
	  below for the hardware present in the system. If unsure, say Y and
	  leave the individual drivers disabled.

if WLAN_VENDOR_UNISOC

source "drivers/net/wireless/unisoc/uwe5622/Kconfig"

endif # WLAN_VENDOR_UNISOC
```

## drivers/net/wireless/unisoc/uwe5622/Kconfig
```kconfig
# SPDX-License-Identifier: GPL-2.0-only

config UWE5622_CORE
	tristate "Unisoc UWE5622 connectivity controller"
	depends on MMC
	select AUXILIARY_BUS
	select CRYPTO_LIB_SHA256
	select FW_LOADER
	help
	  This driver supports the common firmware and transport layer of the
	  Unisoc UWE5622 Wi-Fi and Bluetooth controller. The first supported
	  transport is SDIO, while child drivers use transport-independent
	  logical services. The Bluetooth child driver is found in the
	  Bluetooth device driver menu and needs this core as well.

	  Say M here to build the connectivity core as a module.

config UWE5622_WIFI
	tristate "Unisoc UWE5622 Wi-Fi support"
	depends on UWE5622_CORE
	depends on CFG80211
	select CRC16
	help
	  Fullmac Wi-Fi support for the Unisoc UWE5622. The driver uses the
	  standard cfg80211 interface and supports dynamic station and AP
	  interfaces, including userspace management through iwd.

	  Say M here to build the Wi-Fi child driver as a module.
```

## drivers/phy/allwinner/Kconfig
```kconfig
# SPDX-License-Identifier: GPL-2.0-only
#
# Phy drivers for Allwinner platforms
#
config PHY_SUN4I_USB
	tristate "Allwinner sunxi SoC USB PHY driver"
	depends on ARCH_SUNXI || COMPILE_TEST
	depends on HAS_IOMEM
	depends on RESET_CONTROLLER
	depends on EXTCON
	depends on POWER_SUPPLY
	depends on USB_SUPPORT
	select GENERIC_PHY
	select USB_COMMON
	help
	  Enable this to support the transceiver that is part of Allwinner
	  sunxi SoCs.

	  This driver controls the entire USB PHY block, both the USB OTG
	  parts, as well as the 2 regular USB 2 host PHYs.

config PHY_SUN6I_MIPI_DPHY
	tristate "Allwinner A31 MIPI D-PHY Support"
	depends on ARCH_SUNXI || COMPILE_TEST
	depends on HAS_IOMEM && COMMON_CLK
	depends on RESET_CONTROLLER
	select GENERIC_PHY
	select GENERIC_PHY_MIPI_DPHY
	select REGMAP_MMIO
	help
	  Choose this option if you have an Allwinner SoC with
	  MIPI-DSI support. If M is selected, the module will be
	  called sun6i_mipi_dphy.

config PHY_SUN9I_USB
	tristate "Allwinner sun9i SoC USB PHY driver"
	depends on ARCH_SUNXI || COMPILE_TEST
	depends on HAS_IOMEM
	depends on RESET_CONTROLLER
	depends on USB_SUPPORT
	select USB_COMMON
	select GENERIC_PHY
	help
	  Enable this to support the transceiver that is part of Allwinner
	  sun9i SoCs.

	  This driver controls each individual USB 2 host PHY.

config PHY_SUN50I_USB3
	tristate "Allwinner H6 SoC USB3 PHY driver"
	depends on ARCH_SUNXI || COMPILE_TEST
	depends on HAS_IOMEM && OF
	depends on RESET_CONTROLLER
	select GENERIC_PHY
	help
	  Enable this to support the USB3.0-capable transceiver that is
	  part of Allwinner H6 SoC.

	  This driver controls each individual USB 2+3 host PHY combo.

config PHY_SUN60I_A733_COMBOPHY
	tristate "Allwinner A733 SerDes combo PHY driver"
	depends on ARCH_SUNXI || COMPILE_TEST
	depends on HAS_IOMEM
	select GENERIC_PHY
	select MFD_SYSCON
	help
	  Enable this to support the combo PHY of the Allwinner A733 SerDes
	  subsystem. The PHY is a Cadence design behind an Allwinner wrapper
	  and sits between the PCIe controller and the M.2 or mini PCIe slot
	  of the board. Say Y here if you want to use PCIe on such a board.
```
