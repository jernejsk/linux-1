## Documentation/devicetree/bindings/pci/allwinner,sun60i-a733-pcie.yaml
```yaml
# SPDX-License-Identifier: (GPL-2.0-only OR BSD-2-Clause)
%YAML 1.2
---
$id: http://devicetree.org/schemas/pci/allwinner,sun60i-a733-pcie.yaml#
$schema: http://devicetree.org/meta-schemas/core.yaml#

title: Allwinner A733 PCIe host controller

maintainers:
  - Jernej Skrabec <jernej.skrabec@gmail.com>

description:
  The A733 integrates a single lane DesignWare PCIe controller with a set
  of application registers next to the DBI space.

allOf:
  - $ref: /schemas/pci/snps,dw-pcie.yaml#

properties:
  compatible:
    const: allwinner,sun60i-a733-pcie

  reg:
    items:
      - description: DBI registers
      - description: Application registers
      - description: Configuration space window

  reg-names:
    items:
      - const: dbi
      - const: app
      - const: config

  interrupts:
    maxItems: 1

  interrupt-names:
    const: msi

  legacy-interrupt-controller:
    description: The INTx interrupts, demultiplexed from the SII interrupt
    type: object
    additionalProperties: false
    properties:
      "#address-cells":
        const: 0

      "#interrupt-cells":
        const: 1

      interrupt-controller: true

      interrupt-parent: true

      interrupts:
        maxItems: 1

    required:
      - "#address-cells"
      - "#interrupt-cells"
      - interrupt-controller
      - interrupts

  clocks:
    items:
      - description: Bus clocks from the SerDes subsystem
      - description: Auxiliary clock
      - description: AXI slave clock
      - description: Clock of the interrupt translation block on the master path

  clock-names:
    items:
      - const: dbi
      - const: aux
      - const: slv
      - const: its

  resets:
    items:
      - description: Controller reset
      - description: Power-up reset
      - description: Reset of the interrupt translation block

  reset-names:
    items:
      - const: core
      - const: pwr
      - const: its

  dma-ranges:
    maxItems: 1

  phys:
    maxItems: 1

  phy-names:
    const: pcie-phy

  power-domains:
    maxItems: 1

  reset-gpios:
    description: PERST# signal to the endpoint
    maxItems: 1

  vpcie3v3-supply:
    description: 3.3 V supply of the slot, switched on before PERST# is released

required:
  - compatible
  - reg
  - reg-names
  - interrupts
  - interrupt-names
  - clocks
  - clock-names
  - resets
  - reset-names
  - phys
  - phy-names
  - power-domains
  - legacy-interrupt-controller

unevaluatedProperties: false

examples:
  - |
    #include <dt-bindings/clock/sun60i-a733-ccu.h>
    #include <dt-bindings/clock/sun60i-a733-serdes-ccu.h>
    #include <dt-bindings/gpio/gpio.h>
    #include <dt-bindings/interrupt-controller/arm-gic.h>
    #include <dt-bindings/power/allwinner,sun60i-a733-pck-600.h>
    #include <dt-bindings/reset/sun60i-a733-ccu.h>

    pcie@6000000 {
        compatible = "allwinner,sun60i-a733-pcie";
        reg = <0x06000000 0x400000>,
              <0x06400000 0x2000>,
              <0x20000000 0x1000000>;
        reg-names = "dbi", "app", "config";
        interrupts = <GIC_SPI 153 IRQ_TYPE_LEVEL_HIGH>;
        interrupt-names = "msi";
        #interrupt-cells = <1>;
        interrupt-map-mask = <0 0 0 7>;
        interrupt-map = <0 0 0 1 &pcie_intc 0>,
                        <0 0 0 2 &pcie_intc 1>,
                        <0 0 0 3 &pcie_intc 2>,
                        <0 0 0 4 &pcie_intc 3>;
        clocks = <&serdes_ccu CLK_SERDES_PCIE>,
                 <&ccu CLK_PCIE_AUX>,
                 <&ccu CLK_PCIE_AXI_SLV>,
                 <&ccu CLK_BUS_ITS_PCIE0_ACLK>;
        clock-names = "dbi", "aux", "slv", "its";
        resets = <&ccu RST_BUS_PCIE>,
                 <&ccu RST_BUS_PCIE_PWRUP>,
                 <&ccu RST_BUS_ITS_PCIE0>;
        reset-names = "core", "pwr", "its";
        phys = <&combophy1>;
        phy-names = "pcie-phy";
        power-domains = <&pck600 PD_PCIE>;
        reset-gpios = <&pio 4 13 GPIO_ACTIVE_LOW>;
        device_type = "pci";
        bus-range = <0x0 0xff>;
        num-lanes = <1>;
        max-link-speed = <3>;
        #address-cells = <3>;
        #size-cells = <2>;
        ranges = <0x81000000 0 0x00000000 0x21000000 0 0x00100000>,
                 <0x82000000 0 0x22000000 0x22000000 0 0x06000000>;
        dma-ranges = <0x02000000 0 0x40000000 0x40000000 0 0xc0000000>;

        pcie_intc: legacy-interrupt-controller {
            interrupt-controller;
            #address-cells = <0>;
            #interrupt-cells = <1>;
            interrupt-parent = <&gic>;
            interrupts = <GIC_SPI 152 IRQ_TYPE_LEVEL_HIGH>;
        };
    };

...
```

## Documentation/devicetree/bindings/phy/allwinner,sun50i-a64-usb-phy.yaml
```yaml
# SPDX-License-Identifier: GPL-2.0
%YAML 1.2
---
$id: http://devicetree.org/schemas/phy/allwinner,sun50i-a64-usb-phy.yaml#
$schema: http://devicetree.org/meta-schemas/core.yaml#

title: Allwinner A64 USB PHY

maintainers:
  - Chen-Yu Tsai <wens@csie.org>
  - Maxime Ripard <mripard@kernel.org>

properties:
  "#phy-cells":
    const: 1

  compatible:
    oneOf:
      - enum:
          - allwinner,sun20i-d1-usb-phy
          - allwinner,sun50i-a64-usb-phy
      - items:
          - enum:
              - allwinner,sun50i-a100-usb-phy
              - allwinner,sun55i-a523-usb-phy
              - allwinner,sun60i-a733-usb-phy
          - const: allwinner,sun20i-d1-usb-phy

  reg:
    minItems: 3
    items:
      - description: PHY Control registers
      - description: PHY PMU0 registers
      - description: PHY PMU1 registers
      - description: PHY PMU2 registers

  reg-names:
    minItems: 3
    items:
      - const: phy_ctrl
      - const: pmu0
      - const: pmu1
      - const: pmu2

  clocks:
    minItems: 2
    items:
      - description: USB OTG PHY bus clock
      - description: USB Host 0 PHY bus clock
      - description: USB2 PHY of the USB3 controller bus clock

  clock-names:
    minItems: 2
    items:
      - const: usb0_phy
      - const: usb1_phy
      - const: usb2_phy

  resets:
    minItems: 2
    items:
      - description: USB OTG reset
      - description: USB Host 1 Controller reset
      - description: USB3 Controller reset

  reset-names:
    minItems: 2
    items:
      - const: usb0_reset
      - const: usb1_reset
      - const: usb2_reset

  power-domains:
    maxItems: 1

  usb0_id_det-gpios:
    maxItems: 1
    description: GPIO to the USB OTG ID pin

  usb0_vbus_det-gpios:
    maxItems: 1
    description: GPIO to the USB OTG VBUS detect pin

  usb0_vbus_power-supply:
    description: Power supply to detect the USB OTG VBUS

  usb0_vbus-supply:
    description: Regulator controlling USB OTG VBUS

  usb1_vbus-supply:
    description: Regulator controlling USB1 Host controller

required:
  - "#phy-cells"
  - compatible
  - clocks
  - clock-names
  - reg
  - reg-names
  - resets
  - reset-names

allOf:
  - if:
      properties:
        compatible:
          contains:
            const: allwinner,sun60i-a733-usb-phy
    then:
      properties:
        reg:
          minItems: 4
        reg-names:
          minItems: 4
        clocks:
          minItems: 3
        clock-names:
          minItems: 3
        resets:
          minItems: 3
        reset-names:
          minItems: 3
    else:
      properties:
        reg:
          maxItems: 3
        reg-names:
          maxItems: 3
        clocks:
          maxItems: 2
        clock-names:
          maxItems: 2
        resets:
          maxItems: 2
        reset-names:
          maxItems: 2
        power-domains: false

additionalProperties: false

examples:
  - |
    #include <dt-bindings/gpio/gpio.h>
    #include <dt-bindings/clock/sun50i-a64-ccu.h>
    #include <dt-bindings/reset/sun50i-a64-ccu.h>

    phy@1c19400 {
        #phy-cells = <1>;
        compatible = "allwinner,sun50i-a64-usb-phy";
        reg = <0x01c19400 0x14>,
              <0x01c1a800 0x4>,
              <0x01c1b800 0x4>;
        reg-names = "phy_ctrl",
                    "pmu0",
                    "pmu1";
        clocks = <&ccu CLK_USB_PHY0>,
                 <&ccu CLK_USB_PHY1>;
        clock-names = "usb0_phy",
                      "usb1_phy";
        resets = <&ccu RST_USB_PHY0>,
                 <&ccu RST_USB_PHY1>;
        reset-names = "usb0_reset",
                      "usb1_reset";
        usb0_id_det-gpios = <&pio 7 9 GPIO_ACTIVE_HIGH>; /* PH9 */
        usb0_vbus_power-supply = <&usb_power_supply>;
        usb0_vbus-supply = <&reg_drivevbus>;
        usb1_vbus-supply = <&reg_usb1_vbus>;
    };
```

## Documentation/devicetree/bindings/phy/allwinner,sun60i-a733-combophy.yaml
```yaml
# SPDX-License-Identifier: (GPL-2.0-only OR BSD-2-Clause)
%YAML 1.2
---
$id: http://devicetree.org/schemas/phy/allwinner,sun60i-a733-combophy.yaml#
$schema: http://devicetree.org/meta-schemas/core.yaml#

title: Allwinner A733 SerDes combo PHY

maintainers:
  - Jernej Skrabec <jernej.skrabec@gmail.com>

description:
  The A733 SerDes subsystem contains two Cadence combo PHYs behind an
  Allwinner wrapper. The second one serves either the USB3 controller or
  the PCIe controller, only the PCIe use is described so far.

properties:
  compatible:
    const: allwinner,sun60i-a733-combophy

  reg:
    items:
      - description: Wrapper registers of the PHY
      - description: Cadence PHY registers
      - description: Lane routing registers of the SerDes subsystem

  reg-names:
    items:
      - const: top
      - const: phy
      - const: pipe

  clocks:
    items:
      - description: PHY configuration clock
      - description: PHY reference clock

  clock-names:
    items:
      - const: cfg
      - const: ref

  power-domains:
    maxItems: 1

  allwinner,serdes:
    $ref: /schemas/types.yaml#/definitions/phandle
    description: The SerDes subsystem clock controller, for its syscon

  "#phy-cells":
    const: 0

required:
  - compatible
  - reg
  - reg-names
  - clocks
  - clock-names
  - allwinner,serdes
  - "#phy-cells"

additionalProperties: false

examples:
  - |
    #include <dt-bindings/clock/sun60i-a733-ccu.h>
    #include <dt-bindings/clock/sun6i-rtc.h>

    phy@6c02000 {
        compatible = "allwinner,sun60i-a733-combophy";
        reg = <0x06c02000 0xa00>,
              <0x06ca0000 0x20000>,
              <0x06c06000 0x2000>;
        reg-names = "top", "phy", "pipe";
        clocks = <&ccu CLK_SERDES_PHY>, <&rtc CLK_HOSC_SERDES1>;
        clock-names = "cfg", "ref";
        allwinner,serdes = <&serdes_ccu>;
        power-domains = <&pck600 7>;
        #phy-cells = <0>;
    };

...
```

## Documentation/devicetree/bindings/sound/allwinner,sun50i-h616-ahub.yaml
```yaml
# SPDX-License-Identifier: (GPL-2.0+ OR BSD-2-Clause)
%YAML 1.2
---
$id: http://devicetree.org/schemas/sound/allwinner,sun50i-h616-ahub.yaml#
$schema: http://devicetree.org/meta-schemas/core.yaml#

title: Allwinner H616 Audio Hub

maintainers:
  - Jernej Skrabec <jernej.skrabec@gmail.com>

description:
  The audio hub is a crossbar switch connecting three APBIF DMA interfaces,
  two digital audio mixers and four I2S/PCM controllers. Three of the I2S
  controllers are routed to pins, the second one is wired to the HDMI
  controller.

properties:
  "#sound-dai-cells":
    description:
      The cell contains the index of the I2S/PCM controller, 0 to 3.
    const: 1

  compatible:
    const: allwinner,sun50i-h616-ahub

  reg:
    maxItems: 1

  clocks:
    items:
      - description: Bus Clock
      - description: Module Clock

  clock-names:
    items:
      - const: bus
      - const: mod

  resets:
    maxItems: 1

  dmas:
    items:
      - description: APBIF 0 TX DMA Channel
      - description: APBIF 0 RX DMA Channel
      - description: APBIF 1 TX DMA Channel
      - description: APBIF 1 RX DMA Channel
      - description: APBIF 2 TX DMA Channel
      - description: APBIF 2 RX DMA Channel

  dma-names:
    items:
      - const: tx0
      - const: rx0
      - const: tx1
      - const: rx1
      - const: tx2
      - const: rx2

required:
  - "#sound-dai-cells"
  - compatible
  - reg
  - clocks
  - clock-names
  - resets
  - dmas
  - dma-names

additionalProperties: false

examples:
  - |
    #include <dt-bindings/clock/sun50i-h616-ccu.h>
    #include <dt-bindings/reset/sun50i-h616-ccu.h>

    audio-hub@5097000 {
        compatible = "allwinner,sun50i-h616-ahub";
        reg = <0x05097000 0xb00>;
        clocks = <&ccu CLK_BUS_AUDIO_HUB>, <&ccu CLK_AUDIO_HUB>;
        clock-names = "bus", "mod";
        resets = <&ccu RST_BUS_AUDIO_HUB>;
        dmas = <&dma 3>, <&dma 3>, <&dma 4>, <&dma 4>, <&dma 5>, <&dma 5>;
        dma-names = "tx0", "rx0", "tx1", "rx1", "tx2", "rx2";
        #sound-dai-cells = <1>;
    };

...
```

## Documentation/devicetree/bindings/sound/allwinner,sun8i-a83t-hdmi-audio.yaml
```yaml
# SPDX-License-Identifier: (GPL-2.0-only OR BSD-2-Clause)
%YAML 1.2
---
$id: http://devicetree.org/schemas/sound/allwinner,sun8i-a83t-hdmi-audio.yaml#
$schema: http://devicetree.org/meta-schemas/core.yaml#

title: Allwinner HDMI Audio Card

maintainers:
  - Jernej Skrabec <jernej.skrabec@gmail.com>

description:
  The Allwinner HDMI audio card connects the SoC's internal HDMI I2S
  controller to the I2S input of the Synopsys DesignWare HDMI transmitter.
  The link format and clocking are fixed properties of this connection.

properties:
  compatible:
    const: allwinner,sun8i-a83t-hdmi-audio

  audio-cpu:
    $ref: /schemas/types.yaml#/definitions/phandle
    description: Phandle to the I2S controller connected to HDMI

  audio-codec:
    $ref: /schemas/types.yaml#/definitions/phandle
    description: Phandle to the DesignWare HDMI transmitter

  model:
    $ref: /schemas/types.yaml#/definitions/string
    description: User-visible name of the sound card

required:
  - compatible
  - audio-cpu
  - audio-codec

additionalProperties: false

examples:
  - |
    sound-hdmi {
        compatible = "allwinner,sun8i-a83t-hdmi-audio";
        audio-cpu = <&i2s2>;
        audio-codec = <&hdmi>;
    };

...
```
