## Documentation/devicetree/bindings/clock/allwinner,sun60i-a733-ccu.yaml
```yaml
# SPDX-License-Identifier: (GPL-2.0-only OR BSD-2-Clause)
%YAML 1.2
---
$id: http://devicetree.org/schemas/clock/allwinner,sun60i-a733-ccu.yaml#
$schema: http://devicetree.org/meta-schemas/core.yaml#

title: Allwinner A733 Clock Control Unit

maintainers:
  - Junhui Liu <junhui.liu@pigmoral.tech>

properties:
  "#clock-cells":
    const: 1

  "#reset-cells":
    const: 1

  compatible:
    enum:
      - allwinner,sun60i-a733-ccu
      - allwinner,sun60i-a733-r-ccu

  reg:
    maxItems: 1

  clocks:
    minItems: 4
    maxItems: 7

  clock-names:
    minItems: 4
    maxItems: 7

required:
  - "#clock-cells"
  - "#reset-cells"
  - compatible
  - reg
  - clocks
  - clock-names

allOf:
  - if:
      properties:
        compatible:
          enum:
            - allwinner,sun60i-a733-ccu

    then:
      properties:
        clocks:
          items:
            - description: High Frequency Oscillator (19.2MHz, 24MHz, or 26MHz)
            - description: Low Frequency Oscillator (usually at 32kHz)
            - description: Internal Oscillator
            - description: Low Frequency Oscillator fanout

        clock-names:
          items:
            - const: hosc
            - const: losc
            - const: iosc
            - const: losc-fanout

  - if:
      properties:
        compatible:
          enum:
            - allwinner,sun60i-a733-r-ccu

    then:
      properties:
        clocks:
          items:
            - description: High Frequency Oscillator (19.2MHz, 24MHz, or 26MHz)
            - description: Low Frequency Oscillator (usually at 32kHz)
            - description: Internal Oscillator
            - description: System 24MHz Clock
            - description: Peripherals PLL 0 (200 MHz output)
            - description: Peripherals PLL 0 (300 MHz output)
            - description: Peripherals PLL 1 (300 MHz output)

        clock-names:
          items:
            - const: hosc
            - const: losc
            - const: iosc
            - const: sys-24m
            - const: pll-periph0-200m
            - const: pll-periph0-300m
            - const: pll-periph1-300m

additionalProperties: false

examples:
  - |
    clock-controller@2002000 {
      compatible = "allwinner,sun60i-a733-ccu";
      reg = <0x02002000 0x2000>;
      clocks = <&osc>, <&rtc 0>, <&rtc 2>, <&rtc 1>;
      clock-names = "hosc", "losc", "iosc", "losc-fanout";
      #clock-cells = <1>;
      #reset-cells = <1>;
    };

...
```

## Documentation/devicetree/bindings/clock/allwinner,sun60i-a733-cpu-ccu.yaml
```yaml
# SPDX-License-Identifier: (GPL-2.0+ OR BSD-2-Clause)
%YAML 1.2
---
$id: http://devicetree.org/schemas/clock/allwinner,sun60i-a733-cpu-ccu.yaml#
$schema: http://devicetree.org/meta-schemas/core.yaml#

title: Allwinner A733 CPU Clock Controller

maintainers:
  - Jernej Skrabec <jernej.skrabec@gmail.com>

description:
  The A733 clocks its CPU clusters and the DSU from a block separate from
  the CCU. It holds one PLL per cluster, one for the DSU and a backup PLL,
  plus a clock selector for each of the three consumers.

properties:
  compatible:
    const: allwinner,sun60i-a733-cpu-ccu

  reg:
    maxItems: 1

  clocks:
    items:
      - description: High Frequency Oscillator (DCXO)
      - description: Peripheral PLL doubled output, backup for the clusters
      - description: Peripheral PLL 600 MHz output, backup for the DSU

  clock-names:
    items:
      - const: hosc
      - const: pll-periph0-2x
      - const: pll-periph0-600m

  "#clock-cells":
    const: 1

required:
  - compatible
  - reg
  - clocks
  - clock-names
  - "#clock-cells"

additionalProperties: false

examples:
  - |
    #include <dt-bindings/clock/sun60i-a733-ccu.h>

    clock-controller@8870000 {
        compatible = "allwinner,sun60i-a733-cpu-ccu";
        reg = <0x08870000 0x4000>;
        clocks = <&osc26M>, <&ccu CLK_PLL_PERIPH0_2X>,
                 <&ccu CLK_PLL_PERIPH0_600M>;
        clock-names = "hosc", "pll-periph0-2x", "pll-periph0-600m";
        #clock-cells = <1>;
    };

...
```

## Documentation/devicetree/bindings/clock/allwinner,sun60i-a733-serdes-ccu.yaml
```yaml
# SPDX-License-Identifier: (GPL-2.0-only OR BSD-2-Clause)
%YAML 1.2
---
$id: http://devicetree.org/schemas/clock/allwinner,sun60i-a733-serdes-ccu.yaml#
$schema: http://devicetree.org/meta-schemas/core.yaml#

title: Allwinner A733 SerDes Subsystem Clock Controller

maintainers:
  - Jernej Skrabec <jernej.skrabec@gmail.com>

description:
  The SerDes subsystem of the A733 hosts the USB3 controller and the
  PCIe controller. Its top level registers gate the bus clocks of those
  controllers, select the source of the USB3 PIPE clock and hold the
  reset of the USB2 PHY of the USB3 controller. The combo PHY driver
  needs a few more of the registers, hence the syscon.

properties:
  "#clock-cells":
    const: 1

  "#reset-cells":
    const: 1

  compatible:
    items:
      - const: allwinner,sun60i-a733-serdes-ccu
      - const: syscon

  reg:
    maxItems: 1

  clocks:
    items:
      - description: SerDes AHB clock
      - description: SerDes MBUS clock
      - description: SerDes PHY configuration clock
      - description: USB2 PIPE clock, the internal USB3 PIPE clock source
      - description: USB3 PIPE clock from the combo PHY
    minItems: 4

  clock-names:
    items:
      - const: ahb
      - const: mbus
      - const: cfg
      - const: u2-pipe
      - const: pipe
    minItems: 4

  resets:
    maxItems: 1

required:
  - "#clock-cells"
  - "#reset-cells"
  - compatible
  - reg
  - clocks
  - clock-names
  - resets

additionalProperties: false

examples:
  - |
    #include <dt-bindings/clock/sun60i-a733-ccu.h>
    #include <dt-bindings/reset/sun60i-a733-ccu.h>

    clock-controller@6c00000 {
        compatible = "allwinner,sun60i-a733-serdes-ccu", "syscon";
        reg = <0x06c00000 0x400>;
        clocks = <&ccu CLK_AHB_SERDES>, <&ccu CLK_MBUS_SERDES>,
                 <&ccu CLK_SERDES_PHY>, <&ccu CLK_USB2_U2_PIPE>;
        clock-names = "ahb", "mbus", "cfg", "u2-pipe";
        resets = <&ccu RST_BUS_SERDES>;
        #clock-cells = <1>;
        #reset-cells = <1>;
    };

...
```

## Documentation/devicetree/bindings/display/allwinner,sun50i-h6-de3-wb.yaml
```yaml
# SPDX-License-Identifier: (GPL-2.0-only OR BSD-2-Clause)
%YAML 1.2
---
$id: http://devicetree.org/schemas/display/allwinner,sun50i-h6-de3-wb.yaml#
$schema: http://devicetree.org/meta-schemas/core.yaml#

title: Allwinner DE3 and DE33 Writeback Engine

maintainers:
  - Jernej Skrabec <jernej.skrabec@gmail.com>

properties:
  compatible:
    enum:
      - allwinner,sun50i-h6-de3-wb
      - allwinner,sun50i-h616-de33-wb

  reg:
    minItems: 1
    maxItems: 2

  reg-names:
    items:
      - const: writeback
      - const: rcq

  clocks:
    items:
      - description: Bus clock
      - description: Module clock

  clock-names:
    items:
      - const: bus
      - const: mod

  iommus:
    maxItems: 1

  interrupts:
    maxItems: 1

  resets:
    maxItems: 1

  allwinner,top:
    $ref: /schemas/types.yaml#/definitions/phandle
    description: Phandle to the DE33 top-level clock and routing controller

  ports:
    $ref: /schemas/graph.yaml#/properties/ports

    properties:
      port@0:
        $ref: /schemas/graph.yaml#/$defs/port-base
        description: Inputs from display engine mixers

        properties:
          endpoint@0:
            $ref: /schemas/graph.yaml#/properties/endpoint
            description: Input from mixer 0
            properties:
              reg:
                const: 0

          endpoint@1:
            $ref: /schemas/graph.yaml#/properties/endpoint
            description: Input from mixer 1
            properties:
              reg:
                const: 1

        anyOf:
          - required:
              - endpoint@0
          - required:
              - endpoint@1

        unevaluatedProperties: false

    required:
      - port@0

required:
  - compatible
  - reg
  - clocks
  - clock-names
  - interrupts
  - resets
  - ports

allOf:
  - if:
      properties:
        compatible:
          const: allwinner,sun50i-h616-de33-wb
    then:
      properties:
        reg:
          minItems: 2
        reg-names:
          minItems: 2
        iommus: false
      required:
        - reg-names
        - allwinner,top
    else:
      properties:
        reg:
          maxItems: 1
        reg-names: false
        allwinner,top: false
      required:
        - iommus

additionalProperties: false

examples:
  - |
    #include <dt-bindings/clock/sun8i-de2.h>
    #include <dt-bindings/interrupt-controller/arm-gic.h>
    #include <dt-bindings/reset/sun8i-de2.h>

    writeback@10000 {
        compatible = "allwinner,sun50i-h6-de3-wb";
        reg = <0x10000 0x1000>;
        clocks = <&display_clocks CLK_BUS_WB>,
                 <&display_clocks CLK_WB>;
        clock-names = "bus", "mod";
        resets = <&display_clocks RST_WB>;
        iommus = <&iommu 0>;
        interrupts = <GIC_SPI 78 IRQ_TYPE_LEVEL_HIGH>;

        ports {
            #address-cells = <1>;
            #size-cells = <0>;

            port@0 {
                #address-cells = <1>;
                #size-cells = <0>;
                reg = <0>;

                writeback_in_mixer0: endpoint@0 {
                    reg = <0>;
                    remote-endpoint = <&mixer0_out_writeback>;
                };

                writeback_in_mixer1: endpoint@1 {
                    reg = <1>;
                    remote-endpoint = <&mixer1_out_writeback>;
                };
            };
        };
    };

...
```

## Documentation/devicetree/bindings/display/allwinner,sun55i-a523-edp.yaml
```yaml
# SPDX-License-Identifier: GPL-2.0-only OR BSD-2-Clause
%YAML 1.2
---
$id: http://devicetree.org/schemas/display/allwinner,sun55i-a523-edp.yaml#
$schema: http://devicetree.org/meta-schemas/core.yaml#

title: Allwinner A523 eDP/DP TX Encoder

maintainers:
  - Jernej Skrabec <jernej.skrabec@gmail.com>

description: |
  The Allwinner A523/A527/T527 SoC family embeds an Innosilicon eDP 1.3
  TX controller, fed by TCON-TV1. The controller exposes an AUX
  channel, hot-plug detection and configurable link training, and can
  drive either an internal eDP panel or an external DisplayPort
  connector.

properties:
  compatible:
    enum:
      - allwinner,sun55i-a523-edp
      - allwinner,sun55i-a523-dp

  reg:
    maxItems: 1

  interrupts:
    maxItems: 1

  clocks:
    items:
      - description: Bus interface clock
      - description: Module clock
      - description: 24 MHz reference clock

  clock-names:
    items:
      - const: bus
      - const: mod
      - const: 24m

  resets:
    maxItems: 1

  reset-names:
    const: bus

  power-domains:
    maxItems: 1

  vdd-supply:
    description: Controller core voltage rail.

  vcc-supply:
    description: I/O voltage rail powering the AUX/HPD pads.

  allwinner,training-param-type:
    $ref: /schemas/types.yaml#/definitions/uint32
    enum: [ 0, 1, 2 ]
    default: 0
    description: |
      Selects the link-training swing / pre-emphasis table that
      matches the board:
        0 - low swing (200-350 mV), typical eDP panel.
        1 - high swing (300-450 mV), DP sink with voltage
            attenuation.
        2 - wide swing (200-500 mV), covers both.

  ports:
    $ref: /schemas/graph.yaml#/properties/ports

    properties:
      port@0:
        $ref: /schemas/graph.yaml#/properties/port
        description: Input endpoint, connected to TCON-TV1.

      port@1:
        $ref: /schemas/graph.yaml#/properties/port
        description: |
          Output endpoint, connected to an eDP panel or a DisplayPort
          connector.

    required:
      - port@0
      - port@1

required:
  - compatible
  - reg
  - interrupts
  - clocks
  - clock-names
  - resets
  - reset-names
  - ports

additionalProperties: false

examples:
  - |
    #include <dt-bindings/interrupt-controller/arm-gic.h>

    #define CLK_HDMI_24M	138
    #define CLK_EDP		158
    #define CLK_BUS_EDP	159
    #define RST_BUS_EDP	72

    edp@5720000 {
        compatible = "allwinner,sun55i-a523-dp";
        reg = <0x5720000 0x4000>;
        interrupts = <GIC_SPI 144 IRQ_TYPE_LEVEL_HIGH>;
        clocks = <&ccu CLK_BUS_EDP>,
                 <&ccu CLK_EDP>,
                 <&ccu CLK_HDMI_24M>;
        clock-names = "bus", "mod", "24m";
        resets = <&ccu RST_BUS_EDP>;
        reset-names = "bus";

        ports {
            #address-cells = <1>;
            #size-cells = <0>;

            port@0 {
                reg = <0>;

                endpoint {
                    remote-endpoint = <&tcon_tv1_out_edp>;
                };
            };

            port@1 {
                reg = <1>;

                endpoint {
                    remote-endpoint = <&dp_con_in>;
                };
            };
        };
    };

...
```

## Documentation/devicetree/bindings/media/allwinner,sun50i-h616-deinterlace.yaml
```yaml
# SPDX-License-Identifier: (GPL-2.0 OR BSD-2-Clause)
%YAML 1.2
---
$id: http://devicetree.org/schemas/media/allwinner,sun50i-h616-deinterlace.yaml#
$schema: http://devicetree.org/meta-schemas/core.yaml#

title: Allwinner H616 DI300 Deinterlace

maintainers:
  - Jernej Skrabec <jernej.skrabec@siol.net>

description: |-
  The Allwinner H616 and later has a DI300 deinterlace core used for
  deinterlacing interlaced video content. Unlike the older H3 block, it
  takes up to three temporally adjacent input frames per pass and is
  wired up behind the SoC's system IOMMU.

properties:
  compatible:
    const: allwinner,sun50i-h616-deinterlace

  reg:
    maxItems: 1

  interrupts:
    maxItems: 1

  clocks:
    items:
      - description: Deinterlace bus clock
      - description: Deinterlace module clock

  clock-names:
    items:
      - const: bus
      - const: mod

  resets:
    maxItems: 1

  iommus:
    maxItems: 1

required:
  - compatible
  - reg
  - interrupts
  - clocks
  - clock-names
  - resets
  - iommus

additionalProperties: false

examples:
  - |
    #include <dt-bindings/interrupt-controller/arm-gic.h>
    #include <dt-bindings/clock/sun50i-h616-ccu.h>
    #include <dt-bindings/reset/sun50i-h616-ccu.h>

    deinterlace: deinterlace@1420000 {
        compatible = "allwinner,sun50i-h616-deinterlace";
        reg = <0x01420000 0x40000>;
        clocks = <&ccu CLK_BUS_DEINTERLACE>,
                 <&ccu CLK_DEINTERLACE>;
        clock-names = "bus", "mod";
        resets = <&ccu RST_BUS_DEINTERLACE>;
        interrupts = <GIC_SPI 89 IRQ_TYPE_LEVEL_HIGH>;
        iommus = <&iommu 1>;
    };

...
```
