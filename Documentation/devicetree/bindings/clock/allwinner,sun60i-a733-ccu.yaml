## Documentation/devicetree/bindings/mfd/x-powers,ac200.yaml
```yaml
# SPDX-License-Identifier: (GPL-2.0-only OR BSD-2-Clause)
%YAML 1.2
---
$id: http://devicetree.org/schemas/mfd/x-powers,ac200.yaml#
$schema: http://devicetree.org/meta-schemas/core.yaml#

title: X-Powers AC200 mixed-signal companion IC

maintainers:
  - Jernej Skrabec <jernej.skrabec@gmail.com>

description:
  The AC200 contains an audio codec, a CVBS video encoder, a 100Mbps
  Ethernet PHY, eFuse storage, and an RTC. Its control registers are
  accessed over I2C or Allwinner's RSB bus.

properties:
  compatible:
    const: x-powers,ac200

  reg:
    maxItems: 1

  clocks:
    maxItems: 1

  interrupts:
    maxItems: 1
    description:
      The INTB pin, which is a shared, open drain, level triggered output
      for the TV encoder, Ethernet PHY and RTC interrupts.

  interrupt-controller: true

  '#interrupt-cells':
    const: 1
    description:
      The interrupt number, see include/dt-bindings/mfd/x-powers,ac200.h

  ac-ldoin-supply:
    description:
      The 3.3V supply for the audio codec LDO input.

  ephy-vcc-supply:
    description:
      The 3.3V supply for the Ethernet PHY analog front end.

  rtc-vcc-supply:
    description:
      The 3.3V supply for the RTC.

  tv-vcc-supply:
    description:
      The 3.3V supply for the TV encoder DAC.

  nvmem-cells:
    maxItems: 1

  nvmem-cell-names:
    items:
      - const: bandgap

  ethernet-phy-control:
    type: object
    additionalProperties: false

    properties:
      compatible:
        const: x-powers,ac200-ephy-ctl

      '#clock-cells':
        const: 0

      '#reset-cells':
        const: 0

      nvmem-cells:
        maxItems: 1

      nvmem-cell-names:
        items:
          - const: calibration

      phy-mode:
        enum:
          - mii
          - rmii

      x-powers,phy-address:
        $ref: /schemas/types.yaml#/definitions/uint32
        minimum: 0
        maximum: 31
        description:
          Address the PHY answers to on the MDIO bus. Must match the reg
          of the corresponding ethernet-phy node.

      x-powers,led-active-low:
        type: boolean
        description: The LED outputs drive low when active.

      x-powers,link-led:
        type: boolean
        description: Enable the link/activity LED output pad.

      x-powers,speed-led:
        type: boolean
        description: Enable the speed LED output pad.

      x-powers,duplex-led:
        type: boolean
        description: Enable the duplex LED output pad.

    required:
      - compatible
      - '#clock-cells'
      - '#reset-cells'
      - phy-mode
      - x-powers,phy-address

    dependencies:
      nvmem-cells: [ nvmem-cell-names ]
      nvmem-cell-names: [ nvmem-cells ]

  tv-encoder:
    type: object
    additionalProperties: false

    properties:
      compatible:
        const: x-powers,ac200-tve

      interrupts:
        maxItems: 1
        description: Cable detection interrupt.

      ports:
        $ref: /schemas/graph.yaml#/properties/ports

        properties:
          port@0:
            $ref: /schemas/graph.yaml#/properties/port
            description: Input from the display pipeline, carrying CCIR656.

          port@1:
            $ref: /schemas/graph.yaml#/properties/port
            description: Output to the composite video connector.

        required:
          - port@0
          - port@1

    required:
      - compatible
      - interrupts

  codec:
    type: object
    $ref: /schemas/sound/dai-common.yaml#
    unevaluatedProperties: false

    properties:
      compatible:
        const: x-powers,ac200-codec

      '#sound-dai-cells':
        const: 0

    required:
      - compatible
      - '#sound-dai-cells'

required:
  - compatible
  - reg
  - clocks
  - ac-ldoin-supply
  - ephy-vcc-supply
  - rtc-vcc-supply
  - tv-vcc-supply

dependencies:
  interrupt-controller: [ '#interrupt-cells' ]
  '#interrupt-cells': [ interrupt-controller ]
  nvmem-cells: [ nvmem-cell-names ]
  nvmem-cell-names: [ nvmem-cells ]

additionalProperties: false

examples:
  - |
    #include <dt-bindings/interrupt-controller/irq.h>

    i2c {
        #address-cells = <1>;
        #size-cells = <0>;

        mfd@10 {
            compatible = "x-powers,ac200";
            reg = <0x10>;
            clocks = <&ac200_clk>;
            ac-ldoin-supply = <&reg_aldo2>;
            ephy-vcc-supply = <&reg_aldo2>;
            rtc-vcc-supply = <&reg_aldo2>;
            tv-vcc-supply = <&reg_aldo2>;
            interrupt-parent = <&pio>;
            interrupts = <1 20 IRQ_TYPE_LEVEL_LOW>;
            interrupt-controller;
            #interrupt-cells = <1>;
            nvmem-cells = <&ac200_bg>;
            nvmem-cell-names = "bandgap";

            ethernet-phy-control {
                compatible = "x-powers,ac200-ephy-ctl";
                nvmem-cells = <&ephy_calib>;
                nvmem-cell-names = "calibration";
                #clock-cells = <0>;
                #reset-cells = <0>;
                phy-mode = "rmii";
                x-powers,phy-address = <1>;
                x-powers,link-led;
                x-powers,speed-led;
                x-powers,duplex-led;
            };

            tv-encoder {
                compatible = "x-powers,ac200-tve";
            };

            codec {
                compatible = "x-powers,ac200-codec";
                #sound-dai-cells = <0>;
            };
        };
    };

...
```

## Documentation/devicetree/bindings/net/bluetooth/aicsemi,aic8800d80-bt.yaml
```yaml
# SPDX-License-Identifier: (GPL-2.0-only OR BSD-2-Clause)
%YAML 1.2
---
$id: http://devicetree.org/schemas/net/bluetooth/aicsemi,aic8800d80-bt.yaml#
$schema: http://devicetree.org/meta-schemas/core.yaml#

title: AICSemi AIC8800D80 Bluetooth controller

maintainers:
  - Jernej Skrabec <jernej.skrabec@gmail.com>

description:
  The Bluetooth controller of the AIC8800D80 is attached over a serial port and
  shares its firmware with the wireless part of the same package, which is
  attached over SDIO and described in a separate binding.  The wireless driver
  loads that firmware, so the controller only answers once the wireless side
  came up.

allOf:
  - $ref: bluetooth-controller.yaml#

properties:
  compatible:
    const: aicsemi,aic8800d80-bt

  reset-gpios:
    maxItems: 1
    description: Line holding the Bluetooth part of the device in reset.

  device-wakeup-gpios:
    maxItems: 1
    description: Line the host drives to keep the controller awake.

  host-wakeup-gpios:
    maxItems: 1
    description: Line the controller drives to wake the host.

  vddio-supply:
    description: Supply for the serial port pins of the device.

  max-speed:
    default: 1500000

required:
  - compatible

additionalProperties: false

examples:
  - |
    #include <dt-bindings/gpio/gpio.h>

    serial {
        bluetooth {
            compatible = "aicsemi,aic8800d80-bt";
            reset-gpios = <&pio 1 2 GPIO_ACTIVE_LOW>;
            device-wakeup-gpios = <&pio 1 3 GPIO_ACTIVE_HIGH>;
            host-wakeup-gpios = <&pio 1 4 GPIO_ACTIVE_HIGH>;
            vddio-supply = <&reg_bldo1>;
            max-speed = <1500000>;
        };
    };
```

## Documentation/devicetree/bindings/net/wireless/aicsemi,aic8800d80-fmac.yaml
```yaml
# SPDX-License-Identifier: (GPL-2.0-only OR BSD-2-Clause)
%YAML 1.2
---
$id: http://devicetree.org/schemas/net/wireless/aicsemi,aic8800d80-fmac.yaml#
$schema: http://devicetree.org/meta-schemas/core.yaml#

title: AICSemi AIC8800D80 fullmac wireless SDIO device

maintainers:
  - Jernej Skrabec <jernej.skrabec@gmail.com>

description:
  The AIC8800D80 is an 802.11ax single stream part attached over SDIO.  The
  same package also holds a Bluetooth controller attached over UART, which is
  described in a separate binding.

  The device is powered and reset through the SDIO slot it sits in, so its
  regulators and its reset line belong to the MMC controller node.

allOf:
  - $ref: /schemas/net/wireless/wireless-controller.yaml#

properties:
  compatible:
    enum:
      - aicsemi,aic8800d80-fmac
      - aicsemi,aic8800d80x2-fmac

  reg:
    maxItems: 1

  interrupts:
    maxItems: 1
    description:
      Out of band host wake line, driven by the device while the host is
      suspended.  Only needed on hosts that cannot wake from the in band SDIO
      interrupt.

  interrupt-names:
    const: host-wake

required:
  - compatible
  - reg

additionalProperties: false

examples:
  - |
    #include <dt-bindings/interrupt-controller/irq.h>

    mmc {
        #address-cells = <1>;
        #size-cells = <0>;

        wifi@1 {
            compatible = "aicsemi,aic8800d80-fmac";
            reg = <1>;
            interrupt-parent = <&pio>;
            interrupts = <1 0 IRQ_TYPE_EDGE_RISING>;
            interrupt-names = "host-wake";
        };
    };
```

## Documentation/devicetree/bindings/net/wireless/sprd,uwe5622.yaml
```yaml
# SPDX-License-Identifier: (GPL-2.0-only OR BSD-2-Clause)
%YAML 1.2
---
$id: http://devicetree.org/schemas/net/wireless/sprd,uwe5622.yaml#
$schema: http://devicetree.org/meta-schemas/core.yaml#

title: Unisoc UWE5622 Wi-Fi and Bluetooth controller

maintainers:
  - Jernej Skrabec <jernej.skrabec@gmail.com>

description: |
  The UWE5622 is a combined dual-band 802.11ac and Bluetooth 5 controller.
  Wi-Fi, Bluetooth HCI, firmware control, and power-management messages share
  one multiplexed SDIO function. Boards normally control reset and the 32 kHz
  low-power clock through the parent MMC power sequence.

allOf:
  - $ref: /schemas/net/wireless/wireless-controller.yaml#

properties:
  compatible:
    const: sprd,uwe5622

  reg:
    const: 1

  interrupts:
    minItems: 1
    maxItems: 2
    description:
      Optional out-of-band wake interrupts from the controller. The interrupt
      trigger describes the active polarity of the selected controller output.
      Rising-edge and high-level interrupts select active high; falling-edge
      and low-level interrupts select active low. If they are absent, the SDIO
      in-band interrupt is used for wakeup.

  interrupt-names:
    minItems: 1
    items:
      - enum:
          - bt-host-wake
          - wlan-host-wake
      - enum:
          - bt-host-wake
          - wlan-host-wake
    description:
      Names the controller wake outputs connected to the host. Wake events
      from a radio function are routed to its named output, or to the single
      connected output when only one is wired up.

  sprd,host-wake-duration-ms:
    description:
      Time for which the firmware holds the selected host-wake output active.
    minimum: 10
    maximum: 310
    multipleOf: 10
    default: 20

  bluetooth-enable-gpios:
    maxItems: 1
    description:
      Bluetooth reset/regulator-enable signal. The signal is asserted while
      the HCI device is open and forced inactive during shutdown.

  device-wake-gpios:
    maxItems: 1
    description:
      Optional host-to-controller Bluetooth wake signal.

  wakeup-source: true

required:
  - compatible
  - reg

dependencies:
  interrupts:
    - interrupt-names

unevaluatedProperties: false

examples:
  - |
    #include <dt-bindings/gpio/gpio.h>
    #include <dt-bindings/interrupt-controller/irq.h>

    mmc {
        #address-cells = <1>;
        #size-cells = <0>;
        bus-width = <4>;
        non-removable;
        keep-power-in-suspend;

        wifi@1 {
            compatible = "sprd,uwe5622";
            reg = <1>;
            interrupt-parent = <&gpio>;
            interrupts = <4 IRQ_TYPE_EDGE_RISING>;
            interrupt-names = "bt-host-wake";
            bluetooth-enable-gpios = <&gpio 4 4 GPIO_ACTIVE_HIGH>;
            device-wake-gpios = <&gpio 4 2 GPIO_ACTIVE_HIGH>;
            wakeup-source;
        };
    };
```

## Documentation/devicetree/bindings/net/wireless/xradio,xr819.yaml
```yaml
# SPDX-License-Identifier: (GPL-2.0-only OR BSD-2-Clause)
%YAML 1.2
---
$id: http://devicetree.org/schemas/net/wireless/xradio,xr819.yaml#
$schema: http://devicetree.org/meta-schemas/core.yaml#

title: XRadio XR819 SDIO WiFi

maintainers:
  - Jernej Skrabec <jernej.skrabec@gmail.com>

description: >
  The XR819 is an 802.11b/g/n SDIO WiFi chip. It is a derivative of the
  ST-Ericsson CW1200 and is driven by the same driver.

  The SDIO vendor and device IDs are enough to bind the driver, so the node is
  only needed to describe the out-of-band host wake interrupt or to supply a
  MAC address.

  The chip's reset line and its 32.768 kHz clock should be described with an
  mmc-pwrseq on the SDIO host above it, see
  Documentation/devicetree/bindings/mmc/mmc-pwrseq-simple.yaml.

allOf:
  - $ref: ieee80211.yaml#

properties:
  compatible:
    const: xradio,xr819

  reg:
    description: SDIO function number
    maxItems: 1

  interrupts:
    description: >
      The out-of-band host wake line. When absent, the in-band interrupt
      provided by the SDIO bus is used instead.
    maxItems: 1

  interrupt-names:
    const: host-wake

  local-mac-address: true
  mac-address: true

required:
  - compatible
  - reg

unevaluatedProperties: false

examples:
  - |
    #include <dt-bindings/interrupt-controller/irq.h>

    mmc {
        #address-cells = <1>;
        #size-cells = <0>;

        wifi@1 {
            compatible = "xradio,xr819";
            reg = <1>;
            interrupt-parent = <&pio>;
            interrupts = <6 15 IRQ_TYPE_LEVEL_HIGH>;
            interrupt-names = "host-wake";
        };
    };
```
